## camera_node/components/node_hal/Kconfig
```kconfig
menu "MasterGrow - Cámara (HAL)"

    choice MG_CAMERA_MODEL
        prompt "Sensor de cámara (camera_type)"
        default MG_CAMERA_OV3660
        help
            Define el driver que se compila y el camera_type que el nodo declara.

        config MG_CAMERA_OV3660
            bool "xiao-ov3660 (XIAO ESP32-S3 Sense, integrada)"
        config MG_CAMERA_OV5640
            bool "xiao-ov5640 (módulo opcional, en validación)"
    endchoice

    config MG_CAMERA_XCLK_HZ
        int "Frecuencia XCLK (Hz)"
        default 20000000
        help
            20 MHz es lo habitual. Si aparecen errores de captura o imágenes cortadas, probar 10 MHz.

    config MG_CAMERA_FB_COUNT
        int "Cantidad de framebuffers (PSRAM)"
        default 2
        range 1 4
        help
            Con 2 o más, esp32-camera captura en modo continuo y entrega el cuadro más reciente.

    config MG_CAMERA_VFLIP
        bool "Invertir verticalmente"
        default y
        help
            La OV3660 del XIAO sale invertida de fábrica; ajustar según el montaje.

    config MG_CAMERA_HMIRROR
        bool "Espejar horizontalmente"
        default n

    config MG_CAMERA_BRIGHTNESS
        int "Brillo del sensor (-2 a 2)"
        default 1
        range -2 2

    config MG_CAMERA_CONTRAST
        int "Contraste del sensor (-2 a 2)"
        default 1
        range -2 2

    config MG_CAMERA_SATURATION
        int "Saturación del sensor (-2 a 2)"
        default 2
        range -2 2
        help
            El análisis de color (local_vision) necesita saturación: con -2 (valor del ejemplo
            de Espressif) las hojas quedaban en ~7 % de saturación y no se detectaba la planta.
            Se puede probar en vivo con /control?saturation=N del servidor de depuración.

    config MG_SD_SPI_FREQ_KHZ
        int "Frecuencia SPI de la microSD (kHz)"
        default 20000
        range 400 40000
        help
            20 MHz es seguro para la mayoría de las tarjetas. Si hay errores de lectura/escritura,
            bajar a 10000.

endmenu
```

## camera_node/components/services/storage_queue/Kconfig
```kconfig
menu "MasterGrow - Cola de almacenamiento (SD)"

    config MG_SQ_MAX_PENDING
        int "Máximo de capturas pendientes en la SD"
        default 2000
        range 10 20000
        help
            Al superarlo se borran primero las capturas rutinarias más antiguas
            (Arquitectura §5.2). El índice ocupa ~64 bytes de PSRAM por entrada.

    config MG_SQ_MIN_FREE_PCT
        int "Espacio libre mínimo a conservar (%)"
        default 10
        range 1 50
        help
            Si el espacio libre cae por debajo, se aplica la misma política de limpieza.

    config MG_SQ_FULL_EVENT_USED_PCT
        int "Uso de la SD que dispara el evento sd_full (%)"
        default 80
        range 50 99

endmenu
```

## camera_node/main/Kconfig.projbuild
```kconfig
menu "MasterGrow - Nodo de cámara"

    config MG_NODE_ID
        string "node_id"
        default "cam-01"
        help
            Identificador único en el sistema (Contrato §3.1): cam-NN.

    config MG_FIRMWARE_VERSION
        string "Versión de firmware (se publica en status)"
        default "0.1.0"

    config MG_STATUS_PERIOD_S
        int "Período de republicación del status (s)"
        default 300
        range 30 3600
        help
            El status se publica al conectar y en cada cambio; además se refresca
            periódicamente (RSSI, espacio en SD).

    config MG_CAPTURE_RES
        string "Resolución de captura rutinaria"
        default "SVGA"
        help
            QVGA, VGA, SVGA, XGA, HD, SXGA, UXGA o QXGA. Luego la reemplaza la config remota.

    config MG_CAPTURE_RES_FULL
        string "Resolución completa (eventos, post-actuación, comandos)"
        default "UXGA"

    config MG_CAPTURE_INTERVAL_MIN
        int "Intervalo de captura rutinaria (min)"
        default 120
        range 1 1440
        help
            Contrato §7: capture_interval_min. Para probar, bajarlo a 1.

    config MG_LIGHT_WINDOW_START
        string "Inicio de la ventana de luz (HH:MM, hora local)"
        default "06:00"

    config MG_LIGHT_WINDOW_END
        string "Fin de la ventana de luz (HH:MM, hora local; 00:00 = medianoche)"
        default "00:00"

    config MG_UTC_OFFSET_MIN
        int "Diferencia de la hora local con UTC (min)"
        default -180
        range -720 840
        help
            Argentina: -180 (UTC-3). Se usa solo para evaluar la ventana de luz;
            todas las marcas de tiempo se publican en UTC.

    config MG_TRIGGER_MIN_INTERVAL_S
        int "Intervalo mínimo entre disparos (s), anti-duplicado"
        default 5
        range 0 3600

    config MG_CAPTURE_JPEG_QUALITY
        int "Calidad JPEG (0-63, menor es mejor)"
        default 12
        range 4 63

    config MG_SELFTEST_CAPTURES
        int "Capturas de autoprueba al arrancar (0 = desactivada)"
        default 10
        range 0 1000

    config MG_DEBUG_HTTP
        bool "Servidor HTTP de depuración (/capture.jpg, /status, /control)"
        default y
        help
            SOLO DESARROLLO: no tiene autenticación. Desactivar en producción.

    config MG_DEBUG_HTTP_PORT
        int "Puerto del servidor de depuración"
        default 80
        depends on MG_DEBUG_HTTP

endmenu
```

## components/mg_api/Kconfig
```kconfig
menu "MasterGrow - API HTTP"

    config MG_API_BASE_URL
        string "URL base de la API (con /api/v1)"
        default "http://192.168.1.10:8000/api/v1"
        help
            http:// en la LAN (TLS desactivado por ahora). Sin barra final.

    config MG_API_TOKEN
        string "Token del nodo (Authorization: Bearer)"
        default ""
        help
            Debe coincidir con el de este node_id en API_NODE_TOKENS del backend.
            En C6/B4 pasa a NVS, emitido por POST /nodos.

    config MG_API_TIMEOUT_MS
        int "Timeout de red por operación (ms)"
        default 15000
        range 1000 120000

    config MG_API_USE_TLS
        bool "Usar HTTPS con el bundle de certificados de IDF"
        default n

endmenu
```

## components/mg_mqtt/Kconfig
```kconfig
menu "MasterGrow - MQTT"

    config MG_MQTT_BROKER_URI
        string "URI del broker"
        default "mqtt://192.168.1.10:1883"
        help
            mqtt://host:1883 sin TLS (desarrollo en LAN) o mqtts://host:8883 con TLS.

    config MG_MQTT_USERNAME
        string "Usuario (por convención, el node_id)"
        default ""

    config MG_MQTT_PASSWORD
        string "Contraseña"
        default ""

    config MG_MQTT_USE_TLS
        bool "Usar TLS (mqtts://) con el bundle de certificados de IDF"
        default n
        help
            Desactivado mientras el sistema corre solo en la red local (decisión del proyecto).
            Al activarlo, la URI debe ser mqtts:// y el certificado del broker debe validar
            contra el bundle de CA de ESP-IDF.

    config MG_MQTT_KEEPALIVE_S
        int "Keepalive (s): el LWT se publica tras ~1.5x este tiempo sin contacto"
        default 30
        range 5 600

    config MG_MQTT_MAX_SUBSCRIPTIONS
        int "Máximo de suscripciones registradas"
        default 8
        range 1 32

    config MG_MQTT_MAX_RX_MSG
        int "Tamaño máximo de un mensaje recibido (bytes)"
        default 2048
        range 256 16384
        help
            Los comandos son JSON chicos; las imágenes nunca viajan por MQTT (Contrato §9).

endmenu
```

## components/mg_ota/Kconfig
```kconfig
menu "MasterGrow - OTA"

    config MG_OTA_CONFIRM_TIMEOUT_S
        int "Tiempo para confirmar un firmware nuevo (s)"
        default 180
        range 30 3600
        help
            Un firmware recién instalado arranca "a prueba". Si en este tiempo no logra conectar
            con el broker y la API, el nodo vuelve solo a la versión anterior (rollback).
            Requiere CONFIG_BOOTLOADER_APP_ROLLBACK_ENABLE.

endmenu
```

## components/mg_settings/Kconfig
```kconfig
menu "MasterGrow - Red y servidor (valores por defecto)"

    config MG_SETTINGS_MQTT_PORT
        int "Puerto MQTT del servidor"
        default 1883

    config MG_SETTINGS_API_PORT
        int "Puerto HTTP de la API"
        default 8000

    config MG_SETTINGS_API_PATH
        string "Ruta base de la API"
        default "/api/v1"

endmenu
```

## components/mg_time/Kconfig
```kconfig
menu "MasterGrow - Hora (SNTP)"

    config MG_TIME_NTP_SERVER
        string "Servidor NTP principal"
        default "time.google.com"
        help
            En algunas redes pool.ntp.org no responde por IPv4; time.google.com sí.

    config MG_TIME_NTP_SERVER2
        string "Servidor NTP secundario (vacío = ninguno)"
        default "pool.ntp.org"

    config MG_TIME_NTP_SERVER3
        string "Servidor NTP terciario (vacío = ninguno)"
        default "time.cloudflare.com"

    config MG_TIME_VALID_AFTER_YEAR
        int "Año mínimo para considerar la hora válida"
        default 2025
        help
            Sin sincronizar, el reloj arranca en 1970: cualquier fecha anterior a este año
            se considera hora no válida.

endmenu
```

## components/mg_wifi/Kconfig
```kconfig
menu "MasterGrow - WiFi"

    config MG_WIFI_SSID
        string "SSID"
        default ""
        help
            SSID de la red. No se versiona: va en sdkconfig o en sdkconfig.defaults.local.
            Más adelante lo reemplaza el aprovisionamiento por BLE (credenciales en NVS).

    config MG_WIFI_PASSWORD
        string "Contraseña"
        default ""

    config MG_WIFI_BACKOFF_MIN_MS
        int "Espera mínima antes de reintentar (ms)"
        default 1000
        range 100 60000

    config MG_WIFI_BACKOFF_MAX_MS
        int "Espera máxima entre reintentos (ms)"
        default 60000
        range 1000 600000

    config MG_WIFI_POWER_SAVE
        bool "Habilitar ahorro de energía (modem sleep)"
        default n
        help
            Desactivado por defecto: el ahorro agrega latencia y baja el throughput
            (subida de imágenes y vista en vivo).

endmenu
```

## display_node/main/Kconfig.projbuild
```kconfig
menu "MasterGrow - Nodo de pantalla"

    config MG_NODE_ID
        string "node_id"
        default "disp-01"
        help
            Identificador único en el sistema (Contrato §3.1): disp-NN.

    config MG_FIRMWARE_VERSION
        string "Versión de firmware (se publica en status)"
        default "0.1.0"

    config MG_STALE_AFTER_S
        int "Dato antiguo: segundos sin noticias de un nodo"
        default 660
        range 60 86400
        help
            Los nodos republican su status cada 5 min (CONFIG_MG_STATUS_PERIOD_S de la cámara):
            con 11 min sin datos se marca "dato antiguo" aunque no haya llegado el LWT.

    config MG_UTC_OFFSET_MIN
        int "Huso horario para mostrar horas (minutos respecto de UTC)"
        default -180
        range -720 840

endmenu
```

## nodo_camara/components/node_hal/Kconfig
```kconfig
menu "MasterGrow - Cámara (HAL)"

    choice MG_CAMERA_MODEL
        prompt "Sensor de cámara (camera_type)"
        default MG_CAMERA_OV3660
        help
            Define el driver que se compila y el camera_type que el nodo declara.

        config MG_CAMERA_OV3660
            bool "xiao-ov3660 (XIAO ESP32-S3 Sense, integrada)"
        config MG_CAMERA_OV5640
            bool "xiao-ov5640 (módulo opcional, en validación)"
    endchoice

    config MG_CAMERA_XCLK_HZ
        int "Frecuencia XCLK (Hz)"
        default 20000000
        help
            20 MHz es lo habitual. Si aparecen errores de captura o imágenes cortadas, probar 10 MHz.

    config MG_CAMERA_FB_COUNT
        int "Cantidad de framebuffers (PSRAM)"
        default 2
        range 1 4
        help
            Con 2 o más, esp32-camera captura en modo continuo y entrega el cuadro más reciente.

    config MG_CAMERA_VFLIP
        bool "Invertir verticalmente"
        default y
        help
            La OV3660 del XIAO sale invertida de fábrica; ajustar según el montaje.

    config MG_CAMERA_HMIRROR
        bool "Espejar horizontalmente"
        default n

    config MG_SD_SPI_FREQ_KHZ
        int "Frecuencia SPI de la microSD (kHz)"
        default 20000
        range 400 40000
        help
            20 MHz es seguro para la mayoría de las tarjetas. Si hay errores de lectura/escritura,
            bajar a 10000.

endmenu
```

## nodo_camara/main/Kconfig.projbuild
```kconfig
menu "MasterGrow - Nodo de cámara"

    config MG_NODE_ID
        string "node_id"
        default "cam-01"
        help
            Identificador único en el sistema (Contrato §3.1): cam-NN.

    config MG_FIRMWARE_VERSION
        string "Versión de firmware (se publica en status)"
        default "0.1.0"

    config MG_STATUS_PERIOD_S
        int "Período de republicación del status (s)"
        default 300
        range 30 3600
        help
            El status se publica al conectar y en cada cambio; además se refresca
            periódicamente (RSSI, espacio en SD).

    config MG_CAPTURE_RES
        string "Resolución de captura rutinaria"
        default "SVGA"
        help
            QVGA, VGA, SVGA, XGA, HD, SXGA, UXGA o QXGA. Luego la reemplaza la config remota.

    config MG_CAPTURE_JPEG_QUALITY
        int "Calidad JPEG (0-63, menor es mejor)"
        default 12
        range 4 63

    config MG_SELFTEST_CAPTURES
        int "Capturas de autoprueba al arrancar (0 = desactivada)"
        default 10
        range 0 1000

    config MG_DEBUG_HTTP
        bool "Servidor HTTP de depuración (/capture.jpg, /status, /control)"
        default y
        help
            SOLO DESARROLLO: no tiene autenticación. Desactivar en producción.

    config MG_DEBUG_HTTP_PORT
        int "Puerto del servidor de depuración"
        default 80
        depends on MG_DEBUG_HTTP

endmenu
```
